## config/boards/shields/jaca_corne/Kconfig.defconfig
```kconfig
if SHIELD_JSON_LOWPRO_LFT

config ZMK_KEYBOARD_NAME
    default "json_lowpro_left"

config ZMK_SPLIT_BLE_ROLE_CENTRAL
    default y

endif

if SHIELD_JSON_LOWPRO_RGHT

config ZMK_KEYBOARD_NAME
    default "json_lowpro_right"

endif

if SHIELD_JSON_LOWPRO_LEFT || SHIELD_JSON_LOWPRO_RIGHT

config ZMK_SPLIT
    default y

endif
```

## config/boards/shields/jaca_corne/Kconfig.shield
```kconfig
# Copyright (c) 2021 Casey Webster
# SPDX-License-Identifier: MIT

config SHIELD_JSON_LOWPRO_LEFT
    def_bool $(shields_list_contains,json_lowpro_left)

config SHIELD_JSON_LOWPRO_RIGHT
    def_bool $(shields_list_contains,json_lowpro_right)
```
